## Config.in
```kconfig
# Add project-specific packages for Buildroot here

source "$NERVES_DEFCONFIG_DIR/package/extra-dts/Config.in"
source "$NERVES_DEFCONFIG_DIR/package/bb-k3-image-gen/Config.in"
source "$NERVES_DEFCONFIG_DIR/package/bb-k3-r5-loader/Config.in"
source "$NERVES_DEFCONFIG_DIR/package/ti-linux-firmware/Config.in"
```

## nerves_defconfig
```kconfig
BR2_aarch64=y
BR2_ARM_FPU_VFPV4=y
BR2_TOOLCHAIN_EXTERNAL=y
BR2_TOOLCHAIN_EXTERNAL_CUSTOM=y
BR2_TOOLCHAIN_EXTERNAL_DOWNLOAD=y
BR2_TOOLCHAIN_EXTERNAL_URL="https://github.com/nerves-project/toolchains/releases/download/v1.6.0/nerves_toolchain_aarch64_nerves_linux_gnu-linux_x86_64-1.6.0-DFCA48C.tar.xz"
BR2_TOOLCHAIN_EXTERNAL_CUSTOM_PREFIX="aarch64-nerves-linux-gnu"
BR2_TOOLCHAIN_EXTERNAL_GCC_11=y
BR2_TOOLCHAIN_EXTERNAL_HEADERS_4_19=y
BR2_TOOLCHAIN_EXTERNAL_CUSTOM_GLIBC=y
# BR2_TOOLCHAIN_EXTERNAL_INET_RPC is not set
BR2_TOOLCHAIN_EXTERNAL_CXX=y
BR2_TOOLCHAIN_EXTERNAL_OPENMP=y
BR2_TAR_OPTIONS="--no-same-owner"
BR2_BACKUP_SITE="http://dl.nerves-project.org"
BR2_ENABLE_DEBUG=y
BR2_OPTIMIZE_2=y
BR2_GLOBAL_PATCH_DIR="${BR2_EXTERNAL_NERVES_PATH}/patches"
BR2_REPRODUCIBLE=y
BR2_ROOTFS_SKELETON_CUSTOM=y
BR2_ROOTFS_SKELETON_CUSTOM_PATH="${BR2_EXTERNAL_NERVES_PATH}/board/nerves-common/skeleton"
BR2_INIT_NONE=y
BR2_ROOTFS_DEVICE_TABLE="${BR2_EXTERNAL_NERVES_PATH}/board/nerves-common/device_table.txt"
BR2_ENABLE_LOCALE_WHITELIST="locale-archive"
BR2_GENERATE_LOCALE="en_US.UTF-8"
BR2_ROOTFS_OVERLAY="${BR2_EXTERNAL_NERVES_PATH}/board/nerves-common/rootfs_overlay ${NERVES_DEFCONFIG_DIR}/rootfs_overlay"
BR2_ROOTFS_POST_BUILD_SCRIPT="${BR2_EXTERNAL_NERVES_PATH}/board/nerves-common/post-build.sh ${NERVES_DEFCONFIG_DIR}/post-build.sh"
BR2_ROOTFS_POST_IMAGE_SCRIPT="${NERVES_DEFCONFIG_DIR}/post-createfs.sh"
BR2_LINUX_KERNEL=y
BR2_LINUX_KERNEL_CUSTOM_VERSION=y
BR2_LINUX_KERNEL_CUSTOM_VERSION_VALUE="5.10.120"
BR2_LINUX_KERNEL_PATCH="${NERVES_DEFCONFIG_DIR}/linux"
BR2_LINUX_KERNEL_USE_CUSTOM_CONFIG=y
BR2_LINUX_KERNEL_CUSTOM_CONFIG_FILE="${NERVES_DEFCONFIG_DIR}/linux/linux-5.10.defconfig"
BR2_LINUX_KERNEL_XZ=y
BR2_LINUX_KERNEL_DTS_SUPPORT=y
BR2_LINUX_KERNEL_INTREE_DTS_NAME="ti/k3-j721e-beagleboneai64 ti/k3-j721e-beagleboneai64-no-shared-mem"
BR2_LINUX_KERNEL_DTB_OVERLAY_SUPPORT=y
BR2_LINUX_KERNEL_INSTALL_TARGET=y
BR2_LINUX_KERNEL_NEEDS_HOST_OPENSSL=y
BR2_PACKAGE_BUSYBOX_CONFIG="${BR2_EXTERNAL_NERVES_PATH}/board/nerves-common/busybox.config"
BR2_PACKAGE_BUSYBOX_CONFIG_FRAGMENT_FILES="${NERVES_DEFCONFIG_DIR}/busybox.fragment"
BR2_PACKAGE_ALSA_UTILS=y
BR2_PACKAGE_ALSA_UTILS_APLAY=y
BR2_PACKAGE_ALSA_UTILS_SPEAKER_TEST=y
BR2_PACKAGE_F2FS_TOOLS=y
BR2_PACKAGE_LINUX_FIRMWARE=y
BR2_PACKAGE_LINUX_FIRMWARE_IWLWIFI_22260=y
# BR2_PACKAGE_RNG_TOOLS_JITTERENTROPY_LIBRARY is not set
BR2_PACKAGE_LIBP11=y
BR2_PACKAGE_UNIXODBC=y
BR2_PACKAGE_LIBMNL=y
BR2_PACKAGE_WPA_SUPPLICANT=y
BR2_PACKAGE_WPA_SUPPLICANT_AP_SUPPORT=y
BR2_PACKAGE_WPA_SUPPLICANT_MESH_NETWORKING=y
BR2_PACKAGE_WPA_SUPPLICANT_HOTSPOT=y
BR2_PACKAGE_WPA_SUPPLICANT_DEBUG_SYSLOG=y
BR2_PACKAGE_WPA_SUPPLICANT_WPA3=y
BR2_PACKAGE_WPA_SUPPLICANT_CTRL_IFACE=y
# BR2_TARGET_ROOTFS_TAR is not set
BR2_TARGET_ARM_TRUSTED_FIRMWARE=y
BR2_TARGET_ARM_TRUSTED_FIRMWARE_CUSTOM_GIT=y
BR2_TARGET_ARM_TRUSTED_FIRMWARE_CUSTOM_REPO_URL="https://git.beagleboard.org/beagleboard/arm-trusted-firmware"
BR2_TARGET_ARM_TRUSTED_FIRMWARE_CUSTOM_REPO_VERSION="bbb.io-08.01.00.006"
BR2_TARGET_ARM_TRUSTED_FIRMWARE_PLATFORM="k3"
BR2_TARGET_ARM_TRUSTED_FIRMWARE_TARGET_BOARD="generic"
BR2_TARGET_ARM_TRUSTED_FIRMWARE_BL32_OPTEE=y
BR2_TARGET_ARM_TRUSTED_FIRMWARE_ADDITIONAL_VARIABLES="SPD=opteed"
BR2_TARGET_OPTEE_OS=y
BR2_TARGET_OPTEE_OS_CUSTOM_GIT=y
BR2_TARGET_OPTEE_OS_CUSTOM_REPO_URL="https://git.beagleboard.org/beagleboard/optee_os"
BR2_TARGET_OPTEE_OS_CUSTOM_REPO_VERSION="08.01.00.005"
BR2_TARGET_OPTEE_OS_PLATFORM="k3"
BR2_TARGET_OPTEE_OS_ADDITIONAL_VARIABLES="CFG_ARM64_core=y"
BR2_TARGET_OPTEE_OS_CORE_IMAGES="tee-pager_v2.bin"
BR2_TARGET_UBOOT=y
BR2_TARGET_UBOOT_BUILD_SYSTEM_KCONFIG=y
BR2_TARGET_UBOOT_CUSTOM_GIT=y
BR2_TARGET_UBOOT_CUSTOM_REPO_URL="https://github.com/BeagleBoard/u-boot"
BR2_TARGET_UBOOT_CUSTOM_REPO_VERSION="v2021.01-ti-08.01.00.006"
BR2_TARGET_UBOOT_PATCH="${NERVES_DEFCONFIG_DIR}/uboot"
BR2_TARGET_UBOOT_USE_CUSTOM_CONFIG=y
BR2_TARGET_UBOOT_CUSTOM_CONFIG_FILE="${NERVES_DEFCONFIG_DIR}/uboot/uboot.defconfig"
BR2_TARGET_UBOOT_NEEDS_ATF_BL31=y
# BR2_TARGET_UBOOT_FORMAT_BIN is not set
BR2_TARGET_UBOOT_FORMAT_IMG=y
BR2_TARGET_UBOOT_SPL=y
BR2_TARGET_UBOOT_SPL_NAME="tispl.bin"
BR2_TARGET_UBOOT_CUSTOM_MAKEOPTS="TEE=$(BINARIES_DIR)/tee-pager_v2.bin ATF=$(BINARIES_DIR)/bl31.bin DM=$(BINARIES_DIR)/ipc_echo_testb_mcu1_0_release_strip.xer5f"
BR2_PACKAGE_HOST_UBOOT_TOOLS=y
BR2_PACKAGE_HOST_UBOOT_TOOLS_ENVIMAGE=y
BR2_PACKAGE_HOST_UBOOT_TOOLS_ENVIMAGE_SOURCE="${NERVES_DEFCONFIG_DIR}/uboot/uboot.env"
BR2_PACKAGE_HOST_UBOOT_TOOLS_ENVIMAGE_SIZE="131072"
BR2_NERVES_SYSTEM_NAME="nerves_system_bbai64"
BR2_PACKAGE_BBORG_OVERLAYS=y
BR2_PACKAGE_NBTTY=y
BR2_PACKAGE_NERVES_CONFIG=y
BR2_PACKAGE_EXTRA_DTS=y
BR2_PACKAGE_BB_K3_IMAGE_GEN=y
BR2_PACKAGE_BB_K3_IMAGE_GEN_SOC="j721e"
BR2_PACKAGE_BB_K3_IMAGE_GEN_CONFIG="evm"
BR2_PACKAGE_BB_K3_R5_LOADER_BOARD="j721e_evm"
BR2_PACKAGE_TI_LINUX_FIRMWARE=y
```

## package/Config.in
```kconfig
source "$BR2_EXTERNAL_PERIDIO_PATH/package/bb-k3-image-gen/Config.in"
source "$BR2_EXTERNAL_PERIDIO_PATH/package/bb-k3-r5-loader/Config.in"
source "$BR2_EXTERNAL_PERIDIO_PATH/package/ti-linux-firmware/Config.in"
```

## package/bb-k3-image-gen/Config.in
```kconfig
config BR2_PACKAGE_BB_K3_IMAGE_GEN
	bool "bb-k3-image-gen"
	select BR2_PACKAGE_BB_K3_R5_LOADER
	help
	  Use TI's bb-k3-image-gen to build a separate bare metal
	  boot binary from a separate spl. Currently supports
	  version 08.01.00.006 as default.

	  https://git.beagleboard.org/beagleboard/bb-k3-image-gen

config BR2_PACKAGE_BB_K3_IMAGE_GEN_SOC
	string "SOC type for image gen"
	depends on BR2_PACKAGE_BB_K3_IMAGE_GEN
	help
	  The target SoC option for image gen.
	  For example, "am64x" for AM64X boards.

config BR2_PACKAGE_BB_K3_IMAGE_GEN_CONFIG
	string "CONFIG type for image gen"
	depends on BR2_PACKAGE_BB_K3_IMAGE_GEN
	help
	  The board config option for image gen.
	  Usually "sk" or "evm".
```

## package/bb-k3-r5-loader/Config.in
```kconfig
config BR2_PACKAGE_BB_K3_R5_LOADER
	bool "bb-k3-r5-loader"
	help
	  Separate U-Boot build for R5 cores on TI's k3 boards.
	  Usually used to build tiboot3.bin with bb-k3-image-gen.

config BR2_PACKAGE_BB_K3_R5_LOADER_BOARD
	string "Board to configure for"
	depends on BR2_PACKAGE_BB_K3_R5_LOADER
	help
	  Specify the board to configure the bootloader for.
	  This should be the name of a board under board/ti
	  For example, "am64x_evm".
```
